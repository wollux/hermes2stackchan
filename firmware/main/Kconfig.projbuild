## firmware/main/Kconfig.projbuild
```kconfig
menu "Hermes2StackChan"

config STACKCHAN_WIFI_SSID
    string "WiFi SSID"
    default ""
    help
        Local WiFi SSID. Keep this in the ignored firmware/sdkconfig file.

config STACKCHAN_WIFI_PASSWORD
    string "WiFi password"
    default ""
    help
        Local WiFi password. Keep this in the ignored firmware/sdkconfig file.

config STACKCHAN_MQTT_URI
    string "MQTT broker URI"
    default ""
    help
        MQTT URI such as mqtt://192.168.99.58:1883.

config STACKCHAN_BRIDGE_AUDIO_URL
    string "Bridge audio HTTP endpoint"
    default ""
    help
        HTTP endpoint for recorded WAV uploads, for example http://192.168.99.58:8788/stackchan/audio.

config STACKCHAN_WAKEWORD_LABEL
    string "Wakeword label"
    default "Computer"
    help
        Human-readable wakeword label reported in MQTT status and events.
        This does not train a wakeword by itself; the selected WakeNet model
        must still contain the matching wakeword.

config STACKCHAN_WAKEWORD_MODEL_HINT
    string "WakeNet model hint"
    default "computer"
    help
        Substring used to select the WakeNet model from the ESP-SR model
        partition. Use "hermes" once a Hermes WakeNet model has been added
        to the firmware image. If no matching model exists, firmware falls
        back to the first available WakeNet model and logs a warning.

config STACKCHAN_PAIR_ID
    string "Pair ID"
    default "desk"

config STACKCHAN_STACKCHAN_ID
    string "StackChan ID"
    default "stackchan-desk"

config STACKCHAN_STATUS_INTERVAL_MS
    int "Status publish interval in ms"
    default 5000
    range 1000 60000

config STACKCHAN_DISPLAY_BRIGHTNESS
    int "Display brightness percent"
    default 80
    range 0 100

endmenu
```

## firmware/sdkconfig.defaults
```kconfig
CONFIG_IDF_TARGET="esp32s3"
CONFIG_ESPTOOLPY_FLASHSIZE_16MB=y
CONFIG_ESPTOOLPY_FLASHSIZE="16MB"
CONFIG_ESPTOOLPY_FLASHMODE_DIO=y
CONFIG_ESPTOOLPY_FLASHFREQ_80M=y
CONFIG_FREERTOS_HZ=1000
CONFIG_LOG_DEFAULT_LEVEL_INFO=y
CONFIG_PARTITION_TABLE_CUSTOM=y
CONFIG_PARTITION_TABLE_CUSTOM_FILENAME="partitions.csv"
CONFIG_PARTITION_TABLE_FILENAME="partitions.csv"
CONFIG_SPIRAM=y
CONFIG_SPIRAM_SPEED_80M=y
CONFIG_SPIRAM_MEMTEST=n
CONFIG_SPIRAM_MALLOC_ALWAYSINTERNAL=512
CONFIG_SPIRAM_MALLOC_RESERVE_INTERNAL=65536
```
